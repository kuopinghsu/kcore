## rtos/nuttx/arch/risc-v/Kconfig
```kconfig
# Patch file to add KCORE to existing Kconfig - insert after ARCH_CHIP_BL602
#
# To apply: Insert this config block into the "RISC-V chip selection" choice
# after the ARCH_CHIP_BL602 entry in arch/risc-v/Kconfig

config ARCH_CHIP_KCORE
	bool "KCORE"
	select ARCH_RV32
	select ARCH_RV_ISA_M
	# Atomic instructions not fully tested yet
	# select ARCH_RV_ISA_A
	---help---
		KCORE custom RISC-V processor

# Also add this to the ARCH_CHIP string section:
#       default "kcore" if ARCH_CHIP_KCORE

# And add this near the end before endif # ARCH_RISCV:
# if ARCH_CHIP_KCORE
# source "arch/risc-v/src/kcore/Kconfig"
# endif
```

## rtos/nuttx/arch/risc-v/Kconfig.patch
```kconfig
--- a/arch/risc-v/Kconfig
+++ b/arch/risc-v/Kconfig
@@ -54,6 +54,15 @@ config ARCH_CHIP_BL602
        ---help---
                BouffaloLab BL602(rv32imfc)
 
+config ARCH_CHIP_KCORE
+       bool "KCORE"
+       select ARCH_RV32
+       select ARCH_RV_ISA_M
+       select ARCH_RV_ISA_A
+       ---help---
+               KCORE custom RISC-V processor
+
 config ARCH_CHIP_ESP32C3_LEGACY
        bool "Espressif ESP32-C3 (Legacy)"
        select ARCH_RV32
@@ -554,6 +563,7 @@ config ARCH_CHIP
        default "k230"                  if ARCH_CHIP_K230
        default "sg2000"                if ARCH_CHIP_SG2000
        default "eic7700x"              if ARCH_CHIP_EIC7700X
+       default "kcore"                 if ARCH_CHIP_KCORE
        default "rp23xx-rv"             if ARCH_CHIP_RP23XX_RV
 
 config ARCH_RISCV_INTXCPT_EXTENSIONS
@@ -868,6 +878,9 @@ endif
 if ARCH_CHIP_RP23XX_RV
 source "arch/risc-v/src/rp23xx-rv/Kconfig"
 endif
+if ARCH_CHIP_KCORE
+source "arch/risc-v/src/kcore/Kconfig"
+endif
 
 endif # ARCH_RISCV
```

## rtos/nuttx/arch/risc-v/src/kcore/Kconfig
```kconfig
#
# For a description of the syntax of this configuration file,
# see the file kconfig-language.txt in the NuttX tools repository.
#

if ARCH_CHIP_KCORE

comment "KCORE Configuration Options"

config KCORE_UART0
	bool "UART0"
	default n
	select UART0_SERIALDRIVER
	select ARCH_HAVE_SERIAL_TERMIOS

endif # ARCH_CHIP_KCORE
```

## rtos/nuttx/boards/risc-v/kcore/Kconfig
```kconfig
#
# For a description of the syntax of this configuration file,
# see the file kconfig-language.txt in the NuttX tools repository.
#

choice
	prompt "Select kcore board"
	default ARCH_BOARD_KCORE

config ARCH_BOARD_KCORE
	bool "KCORE development board"
	---help---
		KCORE custom development board

endchoice

if ARCH_BOARD_KCORE
config ARCH_BOARD
	string
	default "kcore-board"

source "boards/risc-v/kcore/kcore-board/Kconfig"
endif
```

## rtos/nuttx/boards/risc-v/kcore/kcore-board/Kconfig
```kconfig
#
# For a description of the syntax of this configuration file,
# see the file kconfig-language.txt in the NuttX tools repository.
#

if ARCH_BOARD_KCORE

config KCORE_UART0
	bool "UART0 Support"
	default y
	select ARCH_HAVE_SERIAL_TERMIOS
	---help---
		Enable UART0 serial console support

config KCORE_UART0_BASE
	hex "UART0 Base Address"
	default 0x10000000
	depends on KCORE_UART0

config KCORE_CLINT_BASE
	hex "CLINT Base Address"
	default 0x200bff8

endif # ARCH_BOARD_KCORE
```

## rtos/nuttx/samples/hello/Kconfig
```kconfig
#
# For a description of the syntax of this configuration file,
# see the file kconfig-language.txt in the NuttX tools repository.
#

config EXAMPLES_HELLO_KCORE
	tristate "\"Hello, kcore!\" example"
	default n
	---help---
		Enable the \"Hello, kcore!\" example for kcore processor

if EXAMPLES_HELLO_KCORE

config EXAMPLES_HELLO_KCORE_PROGNAME
	string "Program name"
	default "hello"
	---help---
		This is the name of the program that will be used when the NSH ELF
		program is installed.

config EXAMPLES_HELLO_KCORE_PRIORITY
	int "Hello task priority"
	default 100

config EXAMPLES_HELLO_KCORE_STACKSIZE
	int "Hello stack size"
	default DEFAULT_TASK_STACKSIZE

endif
```
